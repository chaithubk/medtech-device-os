## yocto/build/conf/bblayers.conf
```bitbake
# BBLAYERS
BBLAYERS ?= " \
  ${TOPDIR}/../poky/meta \
  ${TOPDIR}/../poky/meta-poky \
  ${TOPDIR}/../poky/meta-yocto-bsp \
  ${TOPDIR}/../meta-medtech \
"

BBLAYERS_NON_REMOVABLE ?= " \
  ${TOPDIR}/../poky/meta \
  ${TOPDIR}/../poky/meta-poky \
"
```

## yocto/conf/bblayers.conf.sample
```bitbake
# Minimal bblayers for medtech image on GitHub-hosted runners
BBLAYERS ?= " \
  ${TOPDIR}/../poky/meta \
  ${TOPDIR}/../poky/meta-poky \
  ${TOPDIR}/../meta-openembedded/meta-oe \
  ${TOPDIR}/../meta-openembedded/meta-python \
  ${TOPDIR}/../meta-openembedded/meta-networking \
  ${TOPDIR}/../meta-qt6 \
  ${TOPDIR}/../meta-medtech \
"

# Keep the layer set intentionally tight to reduce clone/build footprint.
# Do not add meta-yocto-bsp or unrelated meta-openembedded sublayers unless required.

BBLAYERS_NON_REMOVABLE ?= " \
  ${TOPDIR}/../poky/meta \
  ${TOPDIR}/../poky/meta-poky \
"
```

## yocto/conf/local.conf.sample
```bitbake
# MedTech Device OS - Stage 1 Build Configuration

MACHINE = "qemuarm64"
DISTRO = "poky"

# Image type (keep only deployable artifact used by CI to reduce disk/time)
IMAGE_FSTYPES = "ext4"

# Build parallel settings.
# GitHub-hosted Linux runners provide 4 vCPUs / 16 GB RAM. 
# Override locally with BB_NUMBER_THREADS / PARALLEL_MAKE env vars for low-RAM hosts.
BB_NUMBER_THREADS ?= "4"
PARALLEL_MAKE     ?= "-j 4"

# Package formats
PACKAGE_CLASSES = "package_ipk"

# Image features
IMAGE_FEATURES += "ssh-server-openssh"
EXTRA_IMAGE_FEATURES = ""
IMAGE_FEATURES:remove = "debug-tweaks dbg-pkgs dev-pkgs tools-debug tools-profile tools-sdk"

# Systemd as init manager
DISTRO_FEATURES:append = " systemd"
VIRTUAL-RUNTIME_init_manager = "systemd"
VIRTUAL-RUNTIME_initscripts = ""

# Qt6 and display support — use OpenGL (EGL/GLES) headless; no Vulkan/Wayland/X11
DISTRO_FEATURES:append = " opengl pam"
DISTRO_FEATURES:remove = "wayland x11 vulkan"

# IPv4/IPv6 networking
DISTRO_FEATURES:append = " ipv4 ipv6"

# Downloads and sstate cache
DL_DIR = "${TOPDIR}/../downloads"
SSTATE_DIR = "${TOPDIR}/../sstate-cache"

# Yocto upstream public sstate mirror — massive CI speedup for poky/oe-core/meta-qt6
# recipes (custom medtech recipes will simply miss and fall through to local build).
# Override with empty string in air-gapped environments.
SSTATE_MIRRORS ?= "\
    file://.* http://sstate.yoctoproject.org/all/PATH;downloadfilename=PATH \n"

# Source pre-mirror — let CI consume already-fetched tarballs first to avoid
# rate-limit / availability flakes on upstream repos.
PREMIRRORS ?= "\
    git://.*/.* http://downloads.yoctoproject.org/mirror/sources/ \n\
    https?://.*/.* http://downloads.yoctoproject.org/mirror/sources/ \n\
    ftp://.*/.* http://downloads.yoctoproject.org/mirror/sources/ \n"

# ============================================================
# Build optimization — GitHub-hosted runner disk constraints
# ============================================================

# Keep SDK machine valid for parser-generated nativesdk variants.
# We do not run populate_sdk in CI, so this does not force SDK artifact generation.
SDKMACHINE = "x86_64"

# Strip debug symbols from binaries (reduces image size significantly)
INHIBIT_PACKAGE_DEBUG_SPLIT = "1"
INHIBIT_PACKAGE_STRIP = "0"
SKIP_PACKAGE_STRIP = "0"

# Do not generate static development output
# Yocto expects DISABLE_STATIC to be a configure-fragment string, not a boolean.
# Using "1" can leak into configure args and create malformed options like
# --without-sendmail1 / --without-libsigsegv-prefix1 in native recipes.
DISABLE_STATIC = " --disable-static"

# Do NOT install development packages (-dev, -staticdev) by default
# This prevents BitBake from building unnecessary development dependencies
DISTRO_FEATURES:remove = "api-documentation doc"

# Disable locale payload bloat
IMAGE_LINGUAS = ""
ENABLE_BINARY_LOCALE_GENERATION = "0"

# Remove task workdirs aggressively to release TMPDIR pressure
INHERIT += "rm_work"
RM_WORK_EXCLUDE += "core-image-medtech"

# Timesys Vigiles SBOM assessment (free tier)
INHERIT += "vigiles"

# Keep git fetches shallow where supported
BB_GIT_SHALLOW = "1"
BB_GIT_SHALLOW_DEPTH = "1"

# Enforce strict checksums — fail immediately on any tarball checksum drift
# instead of silently re-downloading. This catches GitHub tarball regeneration
# before it wastes build time.
BB_STRICT_CHECKSUM = "1"

# ============================================================
# Build resilience & diagnostics
# ============================================================

# Abort when disk is critically low so workflow fails early and clearly
BB_DISKMON_DIRS = "ABORT,${TMPDIR},100M,100K"

# Hash equivalency server — keep local hashserve running so Poky's OEEquivHash
# class does not fail on parse, but do NOT set BB_HASHSERVE_UPSTREAM.
# Adding an upstream endpoint causes BitBake to make a network round-trip to
# hashserv.yoctoproject.org:8686 for every task before checking the sstate
# mirror, which accumulates to ~1.5h of extra build time on a full image build.
# The local hashserve runs in-process with no per-task network overhead.
BB_HASHSERVE = "auto"

# Print failed task output in the terminal with enough context for CI triage
BBINCLUDELOGS = "yes"
BBINCLUDELOGS_LINES = "200"

# ============================================================
# Optional SPDX / SBOM generation toggle
# ============================================================
# Set MEDTECH_ENABLE_SPDX to "1" (or "true") to enable Yocto create-spdx.
# Keep it "0" for faster builds when SPDX artifacts are not required.
MEDTECH_ENABLE_SPDX ?= "0"
INHERIT:append = "${@' create-spdx' if (d.getVar('MEDTECH_ENABLE_SPDX') or '').strip().lower() in ('1', 'true', 'yes', 'on') else ''}"

# SPDX tuning (applies only when create-spdx is enabled)
SPDX_PRETTY = "1"
SPDX_ARCHIVE_COMPRESS = "gz"
SPDX_INCLUDE_SOURCES = "0"
SPDX_DEPLOY_DIR = "${DEPLOY_DIR_IMAGE}/spdx"

# Use a broadly reachable HTTPS endpoint for Yocto connectivity sanity checks
# across both local and CI environments.
CONNECTIVITY_CHECK_URIS = "https://github.com/"

# ============================================================
# Bloat suppression — recipe-level PACKAGECONFIG trims
# Validated via scripts/audit-image-deps.sh against pn-buildlist.
# ============================================================

# systemd: drop optional features that drag in microhttpd/gnutls/dbus-broker/etc.
# hibernate/backlight/quotacheck/randomseed are unused on a QEMU embedded target.
PACKAGECONFIG:remove:pn-systemd = "audit microhttpd gnutls polkit kmod ldconfig binfmt \
                                   hibernate backlight quotacheck randomseed"

# qtbase: keep gui+opengl-es, drop test/tooling/cups/printsupport bloat.
PACKAGECONFIG:remove:pn-qtbase = "tests examples sql-sqlite cups printsupport icu accessibility-atspi"

# qtdeclarative: build-time only, keep minimal.
PACKAGECONFIG:remove:pn-qtdeclarative = "qmltyperegistrar-no-link tools tests examples"

# mosquitto: no websockets / no docs / no bridge tooling we need at runtime.
PACKAGECONFIG:remove:pn-mosquitto = "websockets manpages dns-srv"

# openssh: drop Kerberos/GSSAPI — not used in this deployment.
# Removes libkrb5/libgssapi build dependency and associated runtime libs.
PACKAGECONFIG:remove:pn-openssh = "kerberos"

# qemu-system-native: only used for image testing in CI; drop graphics stack.
# (virglrenderer/mesa/libepoxy native builds disappear.)
PACKAGECONFIG:remove:pn-qemu-native = "virglrenderer epoxy gtk+ sdl vnc spice usb-redir"

# Distro-wide BAD_RECOMMENDATIONS — also enforced in medtech-image.bbclass,
# replicated here so non-medtech builds (e.g. core-image-minimal) benefit too.
BAD_RECOMMENDATIONS:append = " bash-completion bluez5 btrfs-tools curl kbd mosquitto-clients \
    ptest-runner mdadm strace socat libical libmicrohttpd gnutls vala \
    python3-pygobject python3-dbus"

# ============================================================
# Buildhistory — feeds size ranking in audit-image-deps.sh
# ============================================================
INHERIT += "buildhistory"
BUILDHISTORY_COMMIT = "0"

# ============================================================
# Access provisioning (required for SSH login)
# ============================================================
# The image locks root login and disables SSH password authentication.
# Provide one SSH public key line for the managed admin account (medadmin).
#
# AUTO-DETECT (recommended for dev container):
#   Store your SSH public key in .secrets/medtech-admin-key.pub
#   The build system will auto-detect and use it.
#   Example:
#     echo "ssh-ed25519 AAAAC3NzaC1lZDI1NTE5AAAA... you@example.com" > .secrets/medtech-admin-key.pub
#
# MANUAL OVERRIDE (if needed):
#   Set MEDTECH_ADMIN_AUTHORIZED_KEY directly here:
#     MEDTECH_ADMIN_AUTHORIZED_KEY = "ssh-ed25519 AAAAC3NzaC1lZDI1NTE5AAAA... you@example.com"
#
# IMPORTANT:
#   - Store actual keys in .secrets/ (not in git)
#   - A template file was created at .secrets/medtech-admin-key.pub
#   - If not set, SSH login will be disabled (by design)
```

## yocto/meta-medtech/conf/layer.conf
```bitbake
# =============================================================================
# meta-medtech/conf/layer.conf — MedTech Device OS Layer Configuration
# =============================================================================
#
# This file registers the meta-medtech layer with the BitBake build system.
# It is sourced automatically when the layer is listed in bblayers.conf.
#
# See: https://docs.yoctoproject.org/dev/ref-manual/structure.html#meta-layer-conf
# =============================================================================

# ---------------------------------------------------------------------------
# BBPATH — Add this layer's conf/ and classes/ directories to the global
# BitBake search path. BitBake uses BBPATH to locate .conf files and .bbclass
# files referenced by INHERIT or require/include statements in recipes.
# ---------------------------------------------------------------------------
BBPATH .= ":${LAYERDIR}"

# ---------------------------------------------------------------------------
# BBFILES — Register all recipe files (*.bb) and recipe appends (*.bbappend)
# found under any recipes-* subdirectory of this layer. The double-glob
# pattern requires exactly one directory level between recipes-<category>/
# and the .bb file (i.e. recipes-foo/pkgname/pkgname_ver.bb).
# ---------------------------------------------------------------------------
BBFILES += "${LAYERDIR}/recipes-*/*/*.bb \
            ${LAYERDIR}/recipes-*/*/*.bbappend"

# ---------------------------------------------------------------------------
# BBFILE_COLLECTIONS — Unique name for this layer's file collection.
# Used internally by BitBake for conflict detection and layer ordering.
# ---------------------------------------------------------------------------
BBFILE_COLLECTIONS += "meta-medtech"

# ---------------------------------------------------------------------------
# BBFILE_PATTERN_meta-medtech — Regex that matches all files belonging to this
# layer. Used by BitBake to attribute recipes to the correct collection when
# resolving conflicts between layers.
# ---------------------------------------------------------------------------
BBFILE_PATTERN_meta-medtech = "^${LAYERDIR}/"

# ---------------------------------------------------------------------------
# BBFILE_PRIORITY_meta-medtech — Layer priority (higher = wins on conflicts).
# Priority 6 is one step above the default OpenEmbedded layers (priority 5),
# ensuring our customizations (e.g., mosquitto bbappend) take precedence over
# upstream layer recipes when the same package appears in multiple layers.
# ---------------------------------------------------------------------------
BBFILE_PRIORITY_meta-medtech = "6"

# ---------------------------------------------------------------------------
# LAYERDEPENDS_meta-medtech — Layers that must be present for meta-medtech
# to build correctly. BitBake fails fast if any listed dependency is missing.
#
#   core             — Poky/OE-Core: provides base classes, kernel, busybox, etc.
#   openembedded-layer — meta-oe: provides a wide range of additional packages
#                        (e.g., mosquitto, python3 extensions).
#   networking-layer — meta-networking: provides network tools and daemons.
#   qt6-layer        — meta-qt6: provides Qt6 and its build infrastructure,
#                      required by medtech-clinician-ui.
#
# Keep this list explicit and minimal so CI only provisions required layers.
# ---------------------------------------------------------------------------
LAYERDEPENDS_meta-medtech = "core openembedded-layer networking-layer qt6-layer"

# ---------------------------------------------------------------------------
# LAYERSERIES_COMPAT_meta-medtech — Yocto release series this layer supports.
# BitBake warns (but does not fail) if the active Poky release is not listed.
#
#   kirkstone — LTS release (currently used in CI and dev container)
#   langdale  — Short-term release; kept for forward-compatibility testing
#   scarthgap — Next LTS release; listed to ease future migration
#
# When upgrading Yocto, update this list and test all recipes in CI.
# ---------------------------------------------------------------------------
LAYERSERIES_COMPAT_meta-medtech = "kirkstone langdale scarthgap"
```
